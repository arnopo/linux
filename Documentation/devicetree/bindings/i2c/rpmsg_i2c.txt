## Documentation/devicetree/bindings/i2c/rpmsg_i2c.txt
```
virtual I2C over rpmsg
----------------------

Required properties:
- compatible: Must be "i2c-rpbus"
- proc-id: id name of the rpmsg_i2c instance

Example:

	rpmsg-i2C {
		compatible = "i2c-rpbus";
		proc-id = "rpmsg_i2c";
		status = "okay";
	};
```

## Documentation/devicetree/bindings/remoteproc/remoteproc,virtio.yaml
```yaml
# SPDX-License-Identifier: (GPL-2.0 OR BSD-2-Clause)
%YAML 1.2
---
$id: "http://devicetree.org/schemas/remoteproc/remoteproc,virtio.yaml#"
$schema: "http://devicetree.org/meta-schemas/core.yaml#"

title: remote processor virtio DT bindings

maintainers:
  - Bjorn Andersson <bjorn.andersson@linaro.org>
  - Mathieu Poirier <mathieu.poirier@linaro.org>

description: |
  These bindings list a set of generic properties for describing a virtio resource in
  the remote processor device tree node. Whether these properties apply to a particular
  remote processor device depends on the DT bindings for the actual device.

properties:
  $nodename:
    pattern: "^virtio(@.*)?"

  compatible:
    const: virtio,rproc

  reg:
    description:
      Index of the remoteproc virtio device.
    maxItems: 1

  virtio,id:
    description: |
      virtio device ID used to identify different types of virtio devices.
      See https://www.oasis-open.org/committees/tc_home.php?wg_abbrev=virtio for
      more details.
    $ref: /schemas/types.yaml#/definitions/uint32
    maxItems: 1

  memory-region:
    description:
      List of phandles to the reserved memory regions associated with the
      remoteproc virtio device. This is variable and describes the memories shared with
      the remote processor (e.g. remoteproc firmware and carveouts, rpmsg
      vrings, ...).
      (see ../reserved-memory/reserved-memory.txt)

required:
  - compatible
  - reg
  - virtio,id

additionalProperties: false
```

## Documentation/devicetree/bindings/rpmsg/uart_rpmsg_bus.txt
```
RPMsg Uart bus
--------------

This binding provides support for the RPMsg over UART bus.


Required properties:
- compatible: Must be "uart-rpmsg-bus"

Optional Properties:
- max-speed:  The maximum baud rate the device operates at. This valure should
		  only be present if the maximum is less than the slave device
  		  can support.

Example:

/* Uart test */
&uart7 {
	status = "okay";
	rpmsg_uart{
		compatible = "uart-rpmsg-bus";
		max-speed = <19200>;
	};
};
```
